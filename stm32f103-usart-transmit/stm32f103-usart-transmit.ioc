# file: stm32f103-usart-transmit.ioc
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Mcu.Family=STM32F1
Mcu.Name=STM32F103C(8-B)Tx
Mcu.Package=LQFP48
NVIC.PriorityGroup=NVIC_PRIORITYGROUP_4
PA13.Mode=Trace_Asynchronous_SW
PA13.Signal=SYS_JTMS-SWDIO
PA14.Mode=Trace_Asynchronous_SW
PA14.Signal=SYS_JTCK-SWCLK
PB3.Mode=Trace_Asynchronous_SW
PB3.Signal=SYS_JTDO-TRACESWO
ProjectManager.HeapSize=0x200
ProjectManager.StackSize=0x400
ProjectManager.TargetToolchain=Makefile
RCC.AHBFreq_Value=64000000
RCC.APB1CLKDivider=RCC_HCLK_DIV2
RCC.APB1Freq_Value=32000000
RCC.APB1TimFreq_Value=64000000
RCC.APB2Freq_Value=64000000
RCC.APB2TimFreq_Value=64000000
RCC.HCLKFreq_Value=64000000
RCC.PLLMUL=RCC_PLL_MUL16
RCC.SYSCLKFreq_VALUE=64000000
RCC.SYSCLKSource=RCC_SYSCLKSOURCE_PLLCLK
RCC.USBFreq_Value=64000000
board=stm32f103-usart-transmit

// file: Core/Src/main.c
/* USER CODE BEGIN Header */
/**
  ******************************************************************************
  * @file           : main.c
  * @brief          : Main program body
  ******************************************************************************
  * @attention
  *
  * <h2><center>&copy; Copyright (c) 2020 STMicroelectronics.
  * All rights reserved.</center></h2>
  *
  * This software component is licensed by ST under BSD 3-Clause license,
  * the "License"; You may not use this file except in compliance with the
  * License. You may obtain a copy of the License at:
  *                        opensource.org/licenses/BSD-3-Clause
  *
  ******************************************************************************
  */
/* USER CODE END Header */
#include "main.h"
#include "gpio.h"

/* USER CODE BEGIN Includes */
#include "stdio.h"
/* USER CODE END Includes */

/* USER CODE BEGIN PV */

void PC13_init(void) // cmsis lib, init led pin
{
    /* Enable clock to IO port C */
    RCC->APB2ENR |= RCC_APB2ENR_IOPCEN;
    /* Set pin C13 as an output */
    GPIOC->CRH &= ~GPIO_CRH_MODE13; // Clear bits
    GPIOC->CRH |= GPIO_CRH_MODE13;  // Output mode, max 50 MHz
    GPIOC->CRH &= ~GPIO_CRH_CNF13;  // GPIO output push-pull
}

void toggle_PC13(void)
{
  GPIOC->ODR ^= 1<<13;
}

/* USER CODE END PV */

void SystemClock_Config(void);
/* USER CODE BEGIN PFP */
extern void initialise_monitor_handles(void);
/* USER CODE END PFP */

/* USER CODE BEGIN 0 */
void USART1_Init(uint32_t baudrate)
{
  // GPIOA Periph clock enable
  RCC->APB2ENR |= RCC_APB2ENR_IOPAEN;
  RCC->APB2ENR |= RCC_APB2ENR_AFIOEN;

  // USART1 GPIO Configuration
  // PA9    ---> USART1_TX
  // PA10   ---> USART1_RX

  // Set alternate
  GPIOA->CRH |= GPIO_CRH_CNF9;
  GPIOA->CRH |= GPIO_CRH_MODE9_1; // 10: Alternate function output Push-pull

  // GPIOA->CRH |= GPIO_CRH_CNF10_0;
  // GPIOA->CRH &= ~GPIO_CRH_MODE10_0;
  // GPIOA->CRH &= ~GPIO_CRH_MODE10_1;

  // USART1 clock enable
  RCC->APB2ENR |= RCC_APB2ENR_USART1EN;

  USART1->BRR = (uint16_t)(SystemCoreClock/baudrate);

  USART1->CR1 |= USART_CR1_TE; // transmitter enable
  USART1->CR1 |= USART_CR1_RE; // receiver enable
  USART1->CR1 |= USART_CR1_UE; // usart enable

  // Default value
  USART1->CR2 = (uint32_t)(0x00000000);
  USART1->CR3 = (uint32_t)(0x00000000);
}

uint8_t USART1_RX(void)
{
  while ((USART1->SR & USART_SR_RXNE) == 0); // wait for RX ready
  return (uint8_t)USART1->DR;
}

void USART1_TX(uint8_t* data, uint16_t lenght)
{
  uint16_t index = 0;
  while (index<lenght)
  {
    USART1->DR = data[index];
    while ((USART1->SR & USART_SR_TXE) == 0); // wait for TX ready
    index++;
  }
}

/* USER CODE END 0 */

int main(void)
{
  /* USER CODE BEGIN 1 */
#ifdef SEMIHOSTING_ENABLE
  initialise_monitor_handles();
#endif
  /* USER CODE END 1 */

  /* MCU Configuration--------------------------------------------------------*/

  /* Reset of all peripherals, Initializes the Flash interface and the Systick. */

  LL_APB2_GRP1_EnableClock(LL_APB2_GRP1_PERIPH_AFIO);
  LL_APB1_GRP1_EnableClock(LL_APB1_GRP1_PERIPH_PWR);

  NVIC_SetPriorityGrouping(NVIC_PRIORITYGROUP_4);

  /* System interrupt init*/

  /** NOJTAG: JTAG-DP Disabled and SW-DP Enabled
  */
  LL_GPIO_AF_Remap_SWJ_NOJTAG();

  /* Configure the system clock */
  SystemClock_Config();

  /* USER CODE BEGIN SysInit */
  PC13_init();
  /* USER CODE END SysInit */

  /* Initialize all configured peripherals */
  MX_GPIO_Init();

  /* Infinite loop */
  /* USER CODE BEGIN WHILE */

  #ifdef UART_HOSTING
   USART1_Init(9600); // speed baudrate
   char str1[80];
  #endif

  while (1)
  {
    #ifdef SEMIHOSTING_ENABLE
     printf("\nhello printf\n");
     puts("hello puts");
     for(uint32_t i = 0; i < 10e5L; i++) __asm volatile ("nop"); // simple delay
     printf("hello printf\n");
     printf("hello world!\n");
     for(uint32_t i = 0; i < 10e5L; i++) __asm volatile ("nop"); // simple delay
    #endif

    toggle_PC13();
    for(uint32_t i = 0; i < 10e5L; i++) __asm volatile ("nop"); // simple delay

    #ifdef UART_HOSTING
     for(uint8_t i = 0; i<(sizeof(str1)/sizeof(str1[0]));i++) str1[i] = 0; // clear array
     sprintf(str1,"speed = %d\n",9600);
     USART1_TX((uint8_t*)str1,sizeof(str1)/sizeof(str1[0]));
     for(uint32_t i = 0; i < 10e5L; i++) __asm volatile ("nop"); // simple delay
    #endif
    /* USER CODE END WHILE */

  }
}

void SystemClock_Config(void)
{
  LL_FLASH_SetLatency(LL_FLASH_LATENCY_2);
  while(LL_FLASH_GetLatency()!= LL_FLASH_LATENCY_2)
  {
  }
  LL_RCC_HSI_SetCalibTrimming(16);
  LL_RCC_HSI_Enable();

   /* Wait till HSI is ready */
  while(LL_RCC_HSI_IsReady() != 1)
  {

  }
  LL_RCC_PLL_ConfigDomain_SYS(LL_RCC_PLLSOURCE_HSI_DIV_2, LL_RCC_PLL_MUL_16);
  LL_RCC_PLL_Enable();

   /* Wait till PLL is ready */
  while(LL_RCC_PLL_IsReady() != 1)
  {

  }
  LL_RCC_SetAHBPrescaler(LL_RCC_SYSCLK_DIV_1);
  LL_RCC_SetAPB1Prescaler(LL_RCC_APB1_DIV_2);
  LL_RCC_SetAPB2Prescaler(LL_RCC_APB2_DIV_1);
  LL_RCC_SetSysClkSource(LL_RCC_SYS_CLKSOURCE_PLL);

   /* Wait till System clock is ready */
  while(LL_RCC_GetSysClkSource() != LL_RCC_SYS_CLKSOURCE_STATUS_PLL)
  {

  }
  LL_Init1msTick(64000000);
  LL_SetSystemCoreClock(64000000);
}

void Error_Handler(void)
{
}

/************************ (C) COPYRIGHT STMicroelectronics *****END OF FILE****/
